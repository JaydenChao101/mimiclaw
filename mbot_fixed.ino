// generated by mBlock5 for mBot
// fixed version

#include "src/MeRGBLineFollower.h"
#include <MeMCore.h>
#include <Arduino.h>
#include <Wire.h>
#include <SoftwareSerial.h>
#include <MePS2.h>

MeUltrasonicSensor ultrasonic_3(3);
MeDCMotor motor_9(9);
MeDCMotor motor_10(10);
MeRGBLineFollower LightSensorRGB_1(2, 1 - 1);
MePS2 ps2(PORT_5);

float LF_speed = 0;
float turning_speed = 0;
float hand_turn_speed = 0;
float search_speed = 0;
float obstacle_dist = 0;

enum ControlMode {
  MODE_IDLE,
  MODE_AUTO,
  MODE_MANUAL
};

ControlMode current_mode = MODE_IDLE;

void _loop();
void _delay(float seconds);

int speedToMotorValue(float percent) {
  return (int)(percent / 100.0 * 255.0);
}

void stopMotors() {
  motor_9.run(0);
  motor_10.run(0);
}

int getLineState() {
  return LightSensorRGB_1.getPositionState();
}

bool isLineLost(int lineState) {
  return lineState == 15;
}

bool isObstacleDetected(int lineState) {
  float distance = ultrasonic_3.distanceCm();

  // Some ultrasonic reads return 0 when the reading is invalid.
  if (distance <= 0) {
    return false;
  }

  return (distance < obstacle_dist) && !isLineLost(lineState);
}

bool isStartButtonPressed() {
  return analogRead(A7) <= 10;
}

void move(int direction, int speed) {
  int leftSpeed = 0;
  int rightSpeed = 0;

  if (direction == 1) {
    leftSpeed = speed;
    rightSpeed = speed;
  } else if (direction == 2) {
    leftSpeed = -speed;
    rightSpeed = -speed;
  } else if (direction == 3) {
    leftSpeed = -speed;
    rightSpeed = speed;
  } else if (direction == 4) {
    leftSpeed = speed;
    rightSpeed = -speed;
  }

  motor_9.run((9) == M1 ? -(leftSpeed) : (leftSpeed));
  motor_10.run((10) == M1 ? -(rightSpeed) : (rightSpeed));
}

void avoidObstacle() {
  stopMotors();
  _delay(0.2);

  move(4, speedToMotorValue(70));
  _delay(0.28);

  move(1, speedToMotorValue(60));
  _delay(0.65);

  move(3, speedToMotorValue(70));
  _delay(0.28);

  move(1, speedToMotorValue(60));
  _delay(0.95);

  move(3, speedToMotorValue(65));
  _delay(0.28);

  while (isLineLost(getLineState())) {
    _loop();
    move(1, speedToMotorValue(search_speed));
  }

  stopMotors();
}

void auto_mode() {
  int lineState = getLineState();

  if (isObstacleDetected(lineState)) {
    avoidObstacle();
    return;
  }

  if (lineState == 9) {
    move(1, speedToMotorValue(LF_speed));
  } else if (lineState == 11 || lineState == 7 || lineState == 3) {
    move(4, speedToMotorValue(turning_speed));
  } else if (lineState == 13 || lineState == 12 || lineState == 14) {
    move(3, speedToMotorValue(turning_speed));
  } else if (lineState == 15) {
    move(3, speedToMotorValue(search_speed));
  } else {
    move(1, speedToMotorValue(30));
  }
}

void own() {
  if (ps2.ButtonPressed(MeJOYSTICK_LEFT)) {
    move(3, speedToMotorValue(hand_turn_speed));
  } else if (ps2.ButtonPressed(MeJOYSTICK_RIGHT)) {
    move(4, speedToMotorValue(hand_turn_speed));
  } else if (ps2.ButtonPressed(MeJOYSTICK_UP)) {
    move(1, speedToMotorValue(50));
  } else if (ps2.ButtonPressed(MeJOYSTICK_DOWN)) {
    move(2, speedToMotorValue(50));
  } else {
    stopMotors();
  }
}

void updateMode() {
  if (ps2.ButtonPressed(MeJOYSTICK_XSHAPED)) {
    current_mode = MODE_IDLE;
  } else if (ps2.ButtonPressed(MeJOYSTICK_TRIANGLE)) {
    current_mode = MODE_AUTO;
  } else if (ps2.ButtonPressed(MeJOYSTICK_ROUND)) {
    current_mode = MODE_MANUAL;
  }
}

void _delay(float seconds) {
  unsigned long endTime = millis() + (unsigned long)(seconds * 1000.0);
  while (millis() < endTime) {
    _loop();
  }
}

void setup() {
  LightSensorRGB_1.begin();
  LightSensorRGB_1.updataAllSensorValue();
  pinMode(A7, INPUT);
  ps2.begin(115200);

  LF_speed = 55;
  turning_speed = 45;
  hand_turn_speed = 65;
  search_speed = 35;
  obstacle_dist = 10;

  LightSensorRGB_1.setKp(0.5);

  while (!isStartButtonPressed()) {
    _loop();
  }
}

void _loop() {
  LightSensorRGB_1.loop();
  ps2.loop();
}

void loop() {
  _loop();
  updateMode();

  if (!isStartButtonPressed()) {
    current_mode = MODE_IDLE;
    stopMotors();
    return;
  }

  if (current_mode == MODE_AUTO) {
    auto_mode();
  } else if (current_mode == MODE_MANUAL) {
    own();
  } else {
    stopMotors();
  }
}
